## boards/shields/example/Kconfig.defconfig
```kconfig
# 내 키보드의 기본적인 (하드웨어적) 속성들

# 왼손 속성
if SHIELD_EXAMPLE_LEFT

  # 인식될 이름
  config ZMK_KEYBOARD_NAME
      default "My EXAMPLE Board"

  # 내 키보드는 왼손이 컴퓨터와 연결될 것
  # 오른손은 왼손에 연결된다
  config ZMK_SPLIT_ROLE_CENTRAL
      default y

endif

# 오른손 속성
if SHIELD_EXAMPLE_RIGHT
  # ...
endif

# 양손 동일 속성
if SHIELD_EXAMPLE_LEFT || SHIELD_EXAMPLE_RIGHT

  # 내 키보드는 스플릿 키보드이다
  config ZMK_SPLIT
      default y

endif
```

## boards/shields/example/Kconfig.shield
```kconfig
# 내 키보드의 존재를 알리기
# 내 스플릿 키보드의 이름은 EXAMPLE

# SHIELD_{이름}_손 형식
config SHIELD_EXAMPLE_LEFT
    def_bool $(shields_list_contains,example_left)

config SHIELD_EXAMPLE_RIGHT
    def_bool $(shields_list_contains,example_right)
```

## boards/shields/myhand/Kconfig.defconfig
```kconfig
if SHIELD_MYHAND_DONGLE

config ZMK_KEYBOARD_NAME
    default "MyHand"

config ZMK_SPLIT_ROLE_CENTRAL
    default y

config ZMK_USB
	default y
endif

if ZMK_DISPLAY

config I2C
    default y

config SSD1306
    default y

choice ZMK_DISPLAY_WORK_QUEUE
    default ZMK_DISPLAY_WORK_QUEUE_DEDICATED
endchoice

endif

if SHIELD_MYHAND_LEFT || SHIELD_MYHAND_RIGHT || SHIELD_MYHAND_DONGLE

config ZMK_SPLIT
    default y

config ZMK_BLE
	default y

endif
```

## boards/shields/myhand/Kconfig.shield
```kconfig
# Copyright (c) 2020 Pete Johanson
# SPDX-License-Identifier: MIT

config SHIELD_MYHAND_LEFT
    def_bool $(shields_list_contains,myhand_left)

config SHIELD_MYHAND_RIGHT 
    def_bool $(shields_list_contains,myhand_right)

config SHIELD_MYHAND_DONGLE
    def_bool $(shields_list_contains,myhand_dongle)
```

## boards/shields/mykeyball/Kconfig.defconfig
```kconfig
if SHIELD_MYKEYBALL_RIGHT

config ZMK_KEYBOARD_NAME
    default "MyKeyball"

config ZMK_SPLIT_ROLE_CENTRAL
    default y

endif

if SHIELD_MYKEYBALL_LEFT || SHIELD_MYKEYBALL_RIGHT

config ZMK_SPLIT
    default y

endif
```

## boards/shields/mykeyball/Kconfig.shield
```kconfig
# Copyright (c) 2020 Pete Johanson
# SPDX-License-Identifier: MIT

config SHIELD_MYKEYBALL_LEFT
    def_bool $(shields_list_contains,mykeyball_left)

config SHIELD_MYKEYBALL_RIGHT 
    def_bool $(shields_list_contains,mykeyball_right)
```

## config/west.yml
```yaml
manifest:
  remotes:
    - name: zmkfirmware
      url-base: https://github.com/petejohanson
    - name: englmaxi
      url-base: https://github.com/englmaxi/
    - name: hanjin
      url-base: http://github.com/hanjin-kim
  projects:
    - name: zmk
      remote: hanjin
      revision: feat/pointers-move-scroll
      import: app/west.yml
    - name: zmk-config
      remote: englmaxi
      revision: master
  self:
    path: config
```
