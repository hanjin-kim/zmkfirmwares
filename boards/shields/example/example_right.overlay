/*
 * Copyright (c) 2020 Pete Johanson
 *
 * SPDX-License-Identifier: MIT
 */

#include "example.dtsi"

// 기본설정 오버라이드, 스플릿엔 필수
&default_transform {
    col-offset = <6>; // 키맵은 이미 왼손에서부터 열의 개수를 센다
};

// 핀아웃 범위는 왼손과 같지만 오른손에선 순서가 뒤집힌다. 양면기판 아닐경우 확인 필요
// 0열 -> 핀2, 5열 -> 핀7
&kscan0 {
    col-gpios
        = <&pro_micro 2 GPIO_ACTIVE_HIGH>
        , <&pro_micro 3 GPIO_ACTIVE_HIGH>
        , <&pro_micro 4 GPIO_ACTIVE_HIGH>
        , <&pro_micro 5 GPIO_ACTIVE_HIGH>
        , <&pro_micro 6 GPIO_ACTIVE_HIGH>
        , <&pro_micro 7 GPIO_ACTIVE_HIGH>
        ;
};
